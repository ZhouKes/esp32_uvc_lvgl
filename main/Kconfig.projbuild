## main/Kconfig.projbuild
```kconfig
menu "Example Configuration"

    choice EXAMPLE_USB_DEVICE_RHPORT
        prompt "USB Device Peripheral"
        default EXAMPLE_USB_DEVICE_RHPORT_HS if IDF_TARGET_ESP32P4
        default EXAMPLE_USB_DEVICE_RHPORT_FS
        help
            Allows set the USB Peripheral Controller for USB device.

            - High-speed (USB OTG2.0 Peripheral for High-, Full- and Low-speed)
            - Full-speed (USB OTG1.1 Peripheral for Full- and Low-speed)

        config EXAMPLE_USB_DEVICE_RHPORT_HS
            bool "OTG2.0"
            depends on IDF_TARGET_ESP32P4
        config EXAMPLE_USB_DEVICE_RHPORT_FS
            bool "OTG1.1"

    endchoice

endmenu
```

## sdkconfig.defaults
```kconfig
CONFIG_CHERRYUSB=y
CONFIG_CHERRYUSB_DEVICE=y
CONFIG_CHERRYUSB_DEVICE_DWC2_ESP=y
CONFIG_CHERRYUSB_DEVICE_VIDEO=y
CONFIG_SPIRAM=y
CONFIG_SPIRAM_USE_MALLOC=y
CONFIG_FREERTOS_HZ=1000
# CONFIG_LV_BUILD_EXAMPLES is not set
CONFIG_LV_BUILD_DEMOS=y
CONFIG_LV_USE_DEMO_WIDGETS=y
```
